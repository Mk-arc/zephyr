## drivers/gnss/Kconfig.quectel_lc79h
```kconfig
# SPDX-FileCopyrightText: Copyright The Zephyr Project Contributors
# SPDX-License-Identifier: Apache-2.0

config GNSS_QUECTEL_LC79H
	bool "Quectel LC79H GNSS with Host EPO assistance"
	default y
	depends on GNSS && DT_HAS_QUECTEL_LC79H_ENABLED
	depends on GNSS_REFERENCE_FRAME_WGS84
	select MODEM_MODULES
	select MODEM_BACKEND_UART
	select MODEM_CHAT
	select GNSS_PARSE
	select GNSS_NMEA0183
	select GNSS_NMEA0183_MATCH
	help
	  LC79H UART GNSS receiver with NMEA fixes and acknowledged PAIR commands.
	  Assistance acquisition and freshness policy belong to the application.
```

## dts/bindings/gnss/quectel,lc79h.yaml
```yaml
# SPDX-FileCopyrightText: Copyright The Zephyr Project Contributors
# SPDX-License-Identifier: Apache-2.0

description: Quectel LC79H UART GNSS receiver with PAIR Host EPO assistance
compatible: "quectel,lc79h"
include: uart-device.yaml
```
